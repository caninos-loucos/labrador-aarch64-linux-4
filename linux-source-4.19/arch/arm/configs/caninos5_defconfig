## linux-source-4.19/arch/arm/mach-caninos/Kconfig
```kconfig
# SPDX-License-Identifier: GPL-2.0

config MACH_CANINOS
	bool
	select ARM_AMBA
	select ARM_GIC
	select ARM_GLOBAL_TIMER
	select SMP
	select PM
	select CACHE_L2X0
	select CLKSRC_ARM_GLOBAL_TIMER_SCHED_CLOCK
	select GENERIC_IRQ_CHIP
	select HAVE_ARM_SCU
	select HAVE_ARM_TWD
	select HAVE_ARM_ARCH_TIMER
	select HAS_DMA
	select DMADEVICES
	select ARCH_REQUIRE_GPIOLIB
	select ARCH_HAS_OPP
	select ARCH_HAS_CPUFREQ
	select OF_ADDRESS
	select HIGHMEM
	select VFP
	select CANINOS_TIMER
	select RESET_CONTROLLER
	select CANINOS_PM_DOMAINS
	select DMA_CANINOS
```

## linux-source-4.19/drivers/clk/caninos/Kconfig
```kconfig
config CLK_GPU_CANINOS
	bool
	depends on CLK_CANINOS && ARM64

config CLK_CANINOS
	bool "Clock driver for Caninos Labrador SoCs"
	depends on (ARCH_CANINOS || COMPILE_TEST)
	select REGMAP_MMIO
	select RESET_CONTROLLER
	select CLK_GPU_CANINOS if ARM64
	default ARCH_CANINOS
```

## linux-source-4.19/drivers/dma/caninos/Kconfig
```kconfig
config DMA_CANINOS
	bool "Caninos Labrador DMA support"
	depends on ARCH_CANINOS || COMPILE_TEST
	select DMA_ENGINE
	select DMA_VIRTUAL_CHANNELS
	help
	  Enable support for the Caninos Labrador DMA controllers.
```

## linux-source-4.19/drivers/gpu/arm/umplock/Kconfig
```kconfig
config MALI400_UMPLOCK
	tristate "UMP lock support"
	depends on MALI400
	---help---
	  This enables support for the umplock which enable cross-process UMP or
	  dma_buf memory synchronization by holding a system-wide lock for each
	  unique UMP handle or dma_buf name.

	  umplock can be useful if you have a system where there is no buffer
	  manager between your compositor and your applications, or for sharing
	  native pixmap data between processes.

	  Say Y here if your SoC contains a Mali 450 MP GPU;
```

## linux-source-4.19/drivers/gpu/drm/caninos/Kconfig
```kconfig
# SPDX-License-Identifier: GPL-2.0-only
config DRM_CANINOS
	tristate "DRM Support for Caninos Labrador Display Engine"
	depends on DRM && OF && (COMPILE_TEST || ARCH_CANINOS)
	select DRM_GEM_CMA_HELPER
	select DRM_KMS_HELPER
	select DRM_KMS_CMA_HELPER
	select VIDEOMODE_HELPERS
	select SND_SOC_HDMI_CODEC if DRM_CANINOS_HDMI_AUDIO && SND_SOC
	help
	 This is a KMS driver for Caninos Labrador Display Engine.
	 If M is selected the module will be called caninosdrm.

if DRM_CANINOS

config DRM_CANINOS_HDMI_AUDIO
	bool "Enable Caninos Labrador HDMI Audio Interface Support"
	depends on SND_SOC
	depends on DRM_CANINOS
	help
	 This selects support for HDMI Audio Interface. If you want to enable
	 hdmi audio output on Caninos Labrador SBCs, you should select this option.

endif
```

## linux-source-4.19/drivers/mfd/atc260x/Kconfig
```kconfig
    
config MFD_ATC260X
	bool "Actions ATC260x PMICs"
	select MFD_CORE
	select REGMAP_I2C
	select REGMAP_IRQ
	depends on I2C && OF
	help
	  Support for the Actions ATC260x PMICs
	  This driver provides common support for accessing the device, additional 
	  drivers must be enabled in order to use the functionality of the device.

config MFD_ATC260X_AUXADC
	bool "ATC260x PMICs Auxiliary ADC"
	depends on MFD_ATC260X
	help
	  Support for reading the ATC260x PMICs auxiliary ADC inputs.

config MFD_ATC260X_POWEROFF
	bool "ATC260x PMICs Power on/off"
	depends on MFD_ATC260X
	help
	  Support for ATC260x PMICs power buttons.
```

## linux-source-4.19/drivers/net/ethernet/caninos/Kconfig
```kconfig
# SPDX-License-Identifier: GPL-2.0
# Caninos Ethernet devices

config NET_K5_ETHERNET
	bool "Caninos K5 Ethernet devices"
	default y
```

## linux-source-4.19/drivers/phy/caninos/Kconfig
```kconfig
#
# CANINOS PHY SUBSYSTEM
#
config CANINOS_USB2_GENERIC_PHY
	tristate "Caninos USB2 PHY Driver"
	help
	  Enable this to support the USB2 PHY that is part of SOC. This
	  driver takes care of all the PHY functionality.

config CANINOS_USB3_GENERIC_PHY
	tristate "Caninos USB3 PHY Driver"
	help
	  Enable this to support the USB3 PHY that is part of SOC. This
	  driver takes care of all the PHY functionality.
```

## linux-source-4.19/drivers/pinctrl/caninos/Kconfig
```kconfig
config PINCTRL_CANINOS
	bool "Caninos Labrador pin controller driver"
	depends on ARCH_CANINOS
	select PINMUX
	select PINCONF
	select OF_ADDRESS
	select GENERIC_PINCONF
	select GPIOLIB
	select GPIOLIB_IRQCHIP
	select OF_GPIO
	help
	  Say yes here to support the gpio/pin control module on
	  Caninos Labrador SBC.
```

## linux-source-4.19/drivers/reset/caninos/Kconfig
```kconfig
config RESET_CANINOS
	bool "Caninos Labrador reset controller"
	depends on (ARCH_CANINOS || COMPILE_TEST)
	default ARCH_CANINOS
	help
	  This enables the reset controller driver for Caninos Labrador boards.
```

## linux-source-4.19/drivers/soc/caninos/Kconfig
```kconfig
if ARCH_CANINOS || COMPILE_TEST

config CANINOS_PM_DOMAINS
	bool "Caninos SPS power domains"
	depends on PM
	select PM_GENERIC_DOMAINS
	help
	  Say 'y' here to enable support for Smart Power System (SPS)
	  power-gating on Caninos SoC.
	  If unsure, say 'n'.

endif
```

## linux-source-4.19/drivers/usb/caninos/Kconfig
```kconfig
#
# Actions usb2.0 controllers configuration
#

config USB_CANINOS
	tristate "Actions usb2.0 otg support"
	#default y
	---help---
	  The Actions chips have USB2.0 otg controllers. Enable
	  this option if your board uses this chip. If unsure, say N.

	  To compile this driver as a module, choose M here: the
	  module will be called aotg.

config USB_CANINOS_HCD
	tristate "Actions usb2.0 HCD support"
	depends on USB_CANINOS
	#default y
	---help---
	  The Actions USB2.0 otg controllers have USB2.0 host controllers. Enable
	  this option if your board uses this chip. If unsure, say N.
```

## linux-source-4.19/sound/soc/atc260x/Kconfig
```kconfig
config SND_SOC_ACT_CANINOS
	tristate
	depends on SND_SOC

config SND_SOC_ACT_2603C
	tristate
	depends on SND_SOC_ACT_CANINOS

config SND_SOC_ACT_2603C_I2C
	tristate
	depends on SND_SOC_ACT_CANINOS

config SND_SOC_ACT_ALL_PMU_CANINOS
	tristate "SoC Audio support for all Caninos Labrador boards"
	select SND_SOC_ACT_CANINOS
	select SND_SOC_ACT_2603C_I2C
	select SND_SOC_ACT_2603C
	select SND_SOC_GENERIC_DMAENGINE_PCM
	help
	  Say Y if you want to add support for SoC audio on 
	  Caninos Labrador board.
```

## linux-source-4.19/sound/soc/caninos/Kconfig
```kconfig
config SND_SOC_CANINOS
	bool
	depends on SND_SOC

config SND_SOC_CANINOS_CODEC
	bool
	depends on SND_SOC_CANINOS

config SND_SOC_ALL_CANINOS
	bool "SoC Audio support for all Caninos Labrador boards"
	select SND_SOC_CANINOS
	select SND_SOC_CANINOS_CODEC
	select SND_SOC_GENERIC_DMAENGINE_PCM
	depends on MFD_ATC260X
	help
	  Say Y if you want to add support for SoC audio on 
	  Caninos Labrador board.
```
